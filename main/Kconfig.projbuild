## main/Kconfig.projbuild
```kconfig
menu "Project Configuration"

    menu "ESP-NOW Configuration"

        config ESPNOW_PMK
            string "ESP-NOW Primary Master Key (PMK)"
            default ""
            help
              Primary Master Key for ESP-NOW encryption (16 characters).
              Leave empty to disable encryption.
              All nodes in the same ESP-NOW network should use the same PMK.

        config ESPNOW_HEARTBEAT_TIMEOUT_S
            int "Heartbeat Timeout (seconds)"
            default 60
            range 10 600
            help
              If no heartbeat is received from a node within this period,
              the node will be marked as offline.

        config ESPNOW_HEARTBEAT_CHECK_S
            int "Heartbeat Check Interval (seconds)"
            default 10
            range 5 120
            help
              Interval at which the gateway scans the node table to detect
              nodes that have exceeded the heartbeat timeout.

    endmenu

    menu "Sensor Configuration"

        config LD2412_UART_PORT_NUM
            int "LD2412 UART Port Number"
            default 1
            range 0 2
            help
              UART port number for LD2412 sensor communication.

        config LD2412_UART_TX_PIN
            int "LD2412 UART TX GPIO"
            default 16
            help
              GPIO pin for UART TX to LD2412.

        config LD2412_UART_RX_PIN
            int "LD2412 UART RX GPIO"
            default 17
            help
              GPIO pin for UART RX from LD2412.

        config LD2412_REPORT_INTERVAL_MS
            int "LD2412 Minimum Report Interval (ms)"
            default 1000
            range 100 10000
            help
              Minimum interval between data report callbacks in milliseconds.
              The driver still updates its internal data on every frame,
              but the callback will only fire at most once per this interval.

    endmenu

endmenu
```
